## meta-startech-distro/conf/distro/startech.conf
```bitbake
DISTRO = "startech"
DISTRO_NAME = "StarTech RaspberryPi Target Distribution"
DISTRO_VERSION = "1.0"
DISTRO_CODENAME = "scarthgap"

INIT_MANAGER = "systemd"

TCLIBCAPPEND = ""

require conf/distro/include/no-gplv3.inc

require conf/distro/include/security_flags.inc

DISTRO_FEATURES = " \
    acl \
    ext2 \
    ipv4 \
    ipv6 \
    usbhost \
    wifi \
    xattr \
    zeroconf \
    vfat \
    systemd \
    seccomp \
"
```
